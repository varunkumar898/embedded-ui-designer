#include "CustomPackManager.h"
#include "CustomDriverPack.h"
#include "DriverPackRegistry.h"
#include <QStandardPaths>
#include <QDir>
#include <QFile>
#include <QJsonDocument>
#include <QDebug>

namespace driverpack {

CustomPackManager::CustomPackManager(QObject* parent)
    : QObject(parent)
{
    m_customPacksDir = QStandardPaths::writableLocation(QStandardPaths::AppDataLocation) + "/custom_packs";
}

CustomPackManager& CustomPackManager::instance() {
    static CustomPackManager inst;
    return inst;
}

QString CustomPackManager::customPacksDirectory() const {
    return m_customPacksDir;
}

void CustomPackManager::setCustomPacksDirectory(const QString& path) {
    m_customPacksDir = path;
}

DeviceProfile CustomPackManager::createDeviceProfile(const CustomPackDef& pack) {
    DeviceProfile prof;
    prof.name = pack.name;
    prof.family = pack.family.isEmpty() ? "Custom" : pack.family;
    prof.vendor = pack.vendor.isEmpty() ? "Custom" : pack.vendor;
    prof.ram_kb = pack.totalRamKb() > 0 ? pack.totalRamKb() : 128;
    prof.flash_kb = pack.totalFlashKb() > 0 ? pack.totalFlashKb() : 512;
    prof.cpu_speed_mhz = pack.clockSpeedMhz > 0 ? pack.clockSpeedMhz : 64;
    prof.cores = {pack.core + " (" + QString::number(prof.cpu_speed_mhz) + " MHz)"};
    prof.architecture = pack.core;
    prof.required_toolchain = pack.toolchain;
    prof.verified = false; // NEVER verified by default for imported packs
    prof.sources = {QString("imported pack: %1").arg(pack.name)};
    prof.notes = QString("Imported custom MCU pack (generated by %1)").arg(pack.provenance.generatedBy);

    for (const auto& mr : pack.memoryRegions) {
        DeviceProfile::RamRegion rr;
        rr.name = mr.name;
        rr.kb = mr.sizeKb;
        rr.usable_for_framebuffer = mr.usableForFramebuffer;
        prof.ram_regions.append(rr);
    }

    for (const auto& p : pack.peripherals) {
        prof.peripherals.append(p.name);
    }

    prof.supported_frameworks = {"lvgl", "qt-for-mcus", "ugfx", "embedweb"};
    return prof;
}

bool CustomPackManager::installPack(const CustomPackDef& pack, CapabilityDatabase* capDb, QString* error) {
    QStringList validationErrors;
    if (!pack.isValid(&validationErrors)) {
        if (error) *error = "Pack validation failed: " + validationErrors.join("; ");
        return false;
    }

    // Reject packs whose device name or part number collides with a built-in device.
    if (capDb) {
        if (capDb->deviceExists(pack.name) || capDb->deviceExists(pack.partNumber)) {
            if (error) *error = QString("Pack device name/part number collides with a built-in device: %1").arg(pack.name);
            return false;
        }
    }

    QDir dir(m_customPacksDir);
    if (!dir.exists()) {
        dir.mkpath(".");
    }

    const QString cleanName = pack.name;
    const QString filePath = dir.filePath(cleanName + ".json");

    QFile file(filePath);
    if (!file.open(QIODevice::WriteOnly | QIODevice::Truncate | QIODevice::Text)) {
        if (error) *error = QString("Failed to write pack to: %1").arg(filePath);
        return false;
    }

    QJsonDocument doc(pack.toJson());
    file.write(doc.toJson(QJsonDocument::Indented));
    file.close();

    m_packs[pack.name] = pack;

    // Register into CapabilityDatabase
    DeviceProfile prof = createDeviceProfile(pack);
    if (capDb) {
        if (!capDb->addDeviceProfile(prof)) {
            QFile::remove(filePath);
            m_packs.remove(pack.name);
            if (error) *error = QString("Failed to register device profile (built-in collision?): %1").arg(pack.name);
            return false;
        }
    }

    // Register into DriverPackRegistry
    DriverPackRegistry::instance().registerPack(std::make_shared<CustomDriverPack>(pack));

    emit packInstalled(pack.name);
    return true;
}

bool CustomPackManager::uninstallPack(const QString& deviceName, CapabilityDatabase* capDb) {
    if (!m_packs.contains(deviceName)) return false;

    // Build the target path inside the custom_packs directory and verify
    // (including symlink resolution) that it cannot escape that directory.
    QDir baseDir(m_customPacksDir);
    baseDir.mkpath(".");
    const QString baseCanonical = baseDir.canonicalPath();
    const QString targetPath = baseDir.filePath(deviceName + ".json");
    const QString targetCanonical = QFileInfo(targetPath).canonicalFilePath();
    if (targetCanonical.isEmpty() || !targetCanonical.startsWith(baseCanonical + "/")) {
        qWarning() << "Refusing to uninstall: resolved path escapes custom_packs directory:" << targetPath;
        return false;
    }

    if (QFile::exists(targetPath)) {
        QFile::remove(targetPath);
    }

    m_packs.remove(deviceName);
    DriverPackRegistry::instance().unregisterPack("custom:" + deviceName.toStdString());

    if (capDb) {
        capDb->removeDeviceProfile(deviceName);
    }

    emit packUninstalled(deviceName);
    return true;
}

void CustomPackManager::loadInstalledPacks(CapabilityDatabase* capDb) {
    // Unregister any previously loaded custom packs so reload never leaves
    // duplicate entries in the registry.
    for (const QString& name : m_packs.keys()) {
        DriverPackRegistry::instance().unregisterPack("custom:" + name.toStdString());
    }

    m_packs.clear();
    QDir dir(m_customPacksDir);
    if (!dir.exists()) return;

    const QStringList files = dir.entryList(QStringList() << "*.json", QDir::Files);
    for (const QString& fName : files) {
        QFile file(dir.filePath(fName));
        if (file.open(QIODevice::ReadOnly | QIODevice::Text)) {
            QJsonDocument doc = QJsonDocument::fromJson(file.readAll());
            if (doc.isObject()) {
                QStringList errors;
                CustomPackDef pack = CustomPackDef::fromJson(doc.object(), &errors);
                if (pack.isValid()) {
                    m_packs[pack.name] = pack;
                    if (capDb) {
                        capDb->addDeviceProfile(createDeviceProfile(pack));
                    }
                    DriverPackRegistry::instance().registerPack(std::make_shared<CustomDriverPack>(pack));
                } else {
                    qWarning() << "Skipping invalid custom pack:" << fName << errors;
                }
            }
        }
    }

    emit packsReloaded();
}

QList<CustomPackDef> CustomPackManager::installedPacks() const {
    return m_packs.values();
}

bool CustomPackManager::isCustomDevice(const QString& deviceName) const {
    return m_packs.contains(deviceName);
}

CustomPackDef CustomPackManager::getPack(const QString& deviceName) const {
    return m_packs.value(deviceName);
}

} // namespace driverpack
