#include "NxpDriverPack.h"
#include <sstream>
#include <algorithm>

namespace driverpack {

NxpDriverPack::NxpDriverPack() {
    initializeDevices();
}

void NxpDriverPack::initializeDevices() {
    McuDeviceSpec imx;
    imx.partNumber = "MIMXRT1062";
    imx.family = "i.MX RT1060";
    imx.vendor = "NXP Semiconductors";
    imx.architecture = "ARM Cortex-M7";
    imx.core = "Cortex-M7";
    imx.package = "BGA196";
    imx.flashBytes = 8 * 1024 * 1024;  // 8MB QuadSPI Flash
    imx.ramBytes = 1024 * 1024;        // 1MB On-Chip RAM
    imx.maxClockHz = 600000000;        // 600 MHz
    imx.supportedPeripherals = {
        "GPIO", "ADC", "PWM", "UART", "SPI", "I2C", "CAN", "DMA", "ETHERNET"
    };
    imx.connectivity = ConnectivityType::EXTERNAL_MODULE_SUPPORTED;
    imx.defaultToolchain = ToolchainType::MCUXPRESSO_MAKEFILE;
    imx.sourceProvenance = "NXP i.MX RT1060 Processor Reference Manual Rev 3";
    devices.push_back(imx);
}

std::vector<McuDeviceSpec> NxpDriverPack::supportedDevices() const {
    return devices;
}

const McuDeviceSpec* NxpDriverPack::findDevice(const std::string& partNumber) const {
    std::string upper = partNumber;
    std::transform(upper.begin(), upper.end(), upper.begin(), ::toupper);
    for (const auto& dev : devices) {
        std::string devUpper = dev.partNumber;
        std::transform(devUpper.begin(), devUpper.end(), devUpper.begin(), ::toupper);
        if (devUpper == upper) return &dev;
    }
    if (upper.find("RT106") != std::string::npos || upper.find("MIMXRT106") != std::string::npos) {
        if (!devices.empty()) return &devices[0];
    }
    return nullptr;
}

bool NxpDriverPack::validateHardwareRequirements(
    const McuDeviceSpec& device,
    const std::set<std::string>& selectedFeatures,
    std::string& outError) const {
    (void)device;
    (void)selectedFeatures;
    (void)outError;
    return true;
}

GeneratedProject NxpDriverPack::generateProjectTree(
    const McuDeviceSpec& device,
    const std::set<std::string>& selectedFeatures,
    const std::string& projectName) const {
    (void)selectedFeatures;

    GeneratedProject proj;
    proj.projectName = projectName;
    proj.targetMcu = device.partNumber;
    proj.family = device.family;
    proj.vendor = device.vendor;

    proj.directories = { "source", "drivers", "board" };

    proj.files["source/main.c"] = 
        "#include \"fsl_common.h\"\n"
        "#include \"fsl_gpio.h\"\n"
        "#include \"board.h\"\n\n"
        "int main(void) {\n"
        "    BOARD_InitBootPins();\n"
        "    BOARD_InitBootClocks();\n"
        "    while (1) {}\n"
        "    return 0;\n"
        "}\n";

    proj.files["board/board.h"] = 
        "#pragma once\n"
        "void BOARD_InitBootPins(void);\n"
        "void BOARD_InitBootClocks(void);\n";

    proj.files["board/board.c"] = 
        "#include \"board.h\"\n"
        "void BOARD_InitBootPins(void) {}\n"
        "void BOARD_InitBootClocks(void) {}\n";

    proj.files["drivers/fsl_gpio.h"] = "#pragma once\n#include <stdint.h>\n";
    proj.files["drivers/fsl_gpio.c"] = "#include \"fsl_gpio.h\"\n";

    proj.includedDrivers.insert("fsl_gpio");
    proj.files["README.md"] = "# " + projectName + "\n\nNXP MCUXpresso project for " + device.partNumber + " generated by Embedded UI Designer.\n";
    proj.files[".gitignore"] = "Debug/\nRelease/\n*.axf\n";
    proj.buildCommands = { "make -j4" };

    return proj;
}

} // namespace driverpack
