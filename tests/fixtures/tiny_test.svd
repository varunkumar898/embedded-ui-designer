# MyCustomMCU register map
Vendor: AcmeSemi; File version: 1.0
Tiny hand-written SVD test fixture
CPU: CM4 r0p1, little endian, MPU, FPU
Registers are access not given, reset 0x0 unless marked. A register's access mark holds for its fields unless they carry their own. Offsets are from the block's base; lines under a group give offsets from that group; [hi:lo] are bit positions; {n}, {i} and the like mark numbered series; 'fields as' and 'values as' point back to an identical list; <NAME> marks a mode.

## Memory map
0x40013800 USART1 — Universal Synchronous Asynchronous Receiver Transmitter
0x40020000 GPIOA — General Purpose I/O Port A

## GPIOA — General Purpose I/O Port A
Base 0x40020000
0x00 MODER — GPIO port mode register
0x14 ODR — GPIO port output data register
0x18 BSRR — GPIO port bit set/reset register

## USART1 — Universal Synchronous Asynchronous Receiver Transmitter
Base 0x40013800
0x00 CR1 — Control register 1
0x28 TDR — Transmit data register
